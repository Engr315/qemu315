## hw/dma/Kconfig
```kconfig
config RC4030
    bool

config PL080
    bool

config PL330
    bool

config I82374
    bool
    select I8257

config I8257
    bool

config ZYNQ_DEVCFG
    bool
    select REGISTER

config XLNX_ZDMA
    bool

config XILINX_AXI_DMA
  bool

config STP2000
    bool

config SIFIVE_PDMA
    bool

config XLNX_CSU_DMA
    bool
    select REGISTER

config PDMA
  bool
```
